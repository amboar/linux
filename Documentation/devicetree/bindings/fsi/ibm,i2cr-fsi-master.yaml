## Documentation/devicetree/bindings/mmc/sdhci-of-aspeed.yaml
```yaml
# SPDX-License-Identifier: GPL-2.0-or-later
%YAML 1.2
---
$id: http://devicetree.org/schemas/mmc/sdhci-of-aspeed.yaml#
$schema: http://devicetree.org/meta-schemas/core.yaml#

title: ASPEED SD/SDIO/eMMC Controller

maintainers:
  - Andrew Jeffery <andrew@aj.id.au>
  - Ryan Chen <ryanchen.aspeed@gmail.com>

description: |+
  The ASPEED SD/SDIO/eMMC controller exposes two slots implementing the SDIO
  Host Specification v2.00, with 1 or 4 bit data buses, or an 8 bit data bus if
  only a single slot is enabled.

  The two slots are supported by a common configuration area. As the SDHCIs for
  the slots are dependent on the common configuration area, they are described
  as child nodes.

properties:
  compatible:
    enum: [ aspeed,ast2400-sdc, aspeed,ast2500-sdc ]
  reg:
    description: Common configuration registers
  ranges: true
  clocks:
    maxItems: 1
    description: The SD/SDIO controller clock gate
  sdhci:
    type: object
    properties:
      compatible:
        allOf:
          - enum: [ aspeed,ast2400-sdhci, aspeed,ast2500-sdhci ]
          - const: sdhci
      reg:
        description: The SDHCI registers
      clocks:
        maxItems: 1
        description: The SD bus clock
      slot:
        allOf:
          - $ref: /schemas/types.yaml#/definitions/uint32
          - enum: [0, 1]
      interrupts:
        maxItems: 1
        description: The SD interrupt shared between both slots
    required:
      - compatible
      - reg
      - clocks
      - slot
      - interrupts

required:
  - compatible
  - reg
  - ranges
  - clocks

examples:
  - |
    #include <dt-bindings/clock/aspeed-clock.h>
    sdc@1e740000 {
            compatible = "aspeed,ast2500-sdc";
            reg = <0x1e740000 0x100>;
            #address-cells = <1>;
            #size-cells = <1>;
            ranges;
            clocks = <&syscon ASPEED_CLK_GATE_SDCLK>;

            sdhci0: sdhci@1e740100 {
                    compatible = "aspeed,ast2500-sdhci", "sdhci";
                    reg = <0x1e740100 0x100>;
                    slot = <0>;
                    interrupts = <26>;
                    sdhci,auto-cmd12;
                    clocks = <&syscon ASPEED_CLK_SDIO>;
            };

            sdhci1: sdhci@1e740200 {
                    compatible = "aspeed,ast2500-sdhci", "sdhci";
                    reg = <0x1e740200 0x100>;
                    slot = <1>;
                    interrupts = <26>;
                    sdhci,auto-cmd12;
                    clocks = <&syscon ASPEED_CLK_SDIO>;
            };
    };
```

## Documentation/devicetree/bindings/rtc/aspeed,ast2400-rtc.yaml
```yaml
# SPDX-License-Identifier: (GPL-2.0-only OR BSD-2-Clause)
%YAML 1.2
---
$id: http://devicetree.org/schemas/rtc/aspeed,ast2400-rtc.yaml#
$schema: http://devicetree.org/meta-schemas/core.yaml#

title: Aspeed RTCs

maintainers:
  - Andrew Jeffery <andrew@codeconstruct.com.au>

properties:
  compatible:
    enum:
      - aspeed,ast2400-rtc
      - aspeed,ast2500-rtc
      - aspeed,ast2600-rtc

  reg:
    maxItems: 1

  interrupts:
    maxItems: 1

allOf:
  - $ref: rtc.yaml

additionalProperties: false

examples:
  - |
    rtc@1e781000 {
        compatible = "aspeed,ast2400-rtc";
        reg = <0x1e781000 0x18>;
        interrupts = <22>;
    };
```

## Documentation/devicetree/bindings/timer/faraday,fttmr010.yaml
```yaml
# SPDX-License-Identifier: (GPL-2.0-only OR BSD-2-Clause)
%YAML 1.2
---
$id: http://devicetree.org/schemas/timer/faraday,fttmr010.yaml#
$schema: http://devicetree.org/meta-schemas/core.yaml#

title: Faraday Technology timer

description: |
  This timer is a generic IP block from Faraday Technology, embedded in the
  Cortina Systems Gemini SoCs and other designs.

maintainers:
  - Linus Walleij <linus.walleij@linaro.org>
  - Andrew Jeffery <andrew@codeconstruct.com.au>

allOf:
  - if:
      properties:
        compatible:
          items:
            - const: cortina,gemini-timer
    then:
      required: [ syscon ]
  - if:
      properties:
        compatible:
          const: aspeed,ast2400-timer
    then:
      properties:
        interrupts:
          maxItems: 8
  - if:
      properties:
        compatible:
          const: aspeed,ast2600-timer
    then:
      properties:
        interrupts-extended:
          maxItems: 8

properties:
  compatible:
    oneOf:
      - const: faraday,fttmr010
      - items:
          - enum:
              - cortina,gemini-timer
              - moxa,moxart-timer
          - const: faraday,fttmr010
      - enum:
          - aspeed,ast2400-timer
          - aspeed,ast2500-timer
          - aspeed,ast2600-timer

  reg:
    maxItems: 1

  interrupts: true

  clocks:
    minItems: 1
    maxItems: 2

  clock-names:
    minItems: 1
    maxItems: 2
    anyOf:
      - enum:
          - EXTCLK
          - PCLK
    description: |
      Use EXTCLK for the external tick timer and PCLK for the peripheral clock.

  syscon:
    maxItems: 1
    description: |
      A phandle to the global Gemini system controller if the compatible type is
      "cortina,gemini-timer"

required:
  - compatible
  - reg
  - interrupts

additionalProperties: false

examples:
  - |
    #include <dt-bindings/interrupt-controller/irq.h>
    timer@43000000 {
        compatible = "faraday,fttmr010";
        reg = <0x43000000 0x1000>;
        interrupts = <14 IRQ_TYPE_EDGE_FALLING>, /* Timer 1 */
               <15 IRQ_TYPE_EDGE_FALLING>, /* Timer 2 */
               <16 IRQ_TYPE_EDGE_FALLING>; /* Timer 3 */
        clocks = <&extclk>, <&pclk>;
        clock-names = "EXTCLK", "PCLK";
    };
```

## Documentation/devicetree/bindings/usb/aspeed,ast2400-uhci.yaml
```yaml
# SPDX-License-Identifier: GPL-2.0
%YAML 1.2
---
$id: http://devicetree.org/schemas/usb/aspeed,ast2400-uhci.yaml#
$schema: http://devicetree.org/meta-schemas/core.yaml#

title: Aspeed (not so) Universal Host Controller Interface

maintainers:
  - Andrew Jeffery <andrew@codeconstruct.com.au>

description: |
  The Aspeed UHCI controllers have quirks with e.g. register layout that
  requires remapping by otherwise generic driver implementations.

allOf:
  - $ref: usb.yaml#

properties:
  compatible:
    items:
      - enum:
          - aspeed,ast2400-uhci
          - aspeed,ast2500-uhci
          - aspeed,ast2600-uhci
      - const: generic-uhci

additionalProperties: true

examples:
  - |
    uhci: usb@1e6b0000 {
        compatible = "aspeed,ast2400-uhci", "generic-uhci";
        reg = <0x1e6b0000 0x100>;
        interrupts = <14>;
        #ports = <3>;
        clocks = <&syscon ASPEED_CLK_GATE_USBUHCICLK>;
        status = "disabled";
    };
```
