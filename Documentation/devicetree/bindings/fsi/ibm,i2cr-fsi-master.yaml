## Documentation/devicetree/bindings/fsi/ibm,i2cr-fsi-master.yaml
```yaml
# SPDX-License-Identifier: (GPL-2.0-only OR BSD-2-Clause)
%YAML 1.2
---
$id: http://devicetree.org/schemas/fsi/ibm,i2cr-fsi-master.yaml#
$schema: http://devicetree.org/meta-schemas/core.yaml#

title: IBM I2C Responder virtual FSI master

maintainers:
  - Eddie James <eajames@linux.ibm.com>

description: |
  The I2C Responder (I2CR) is a an I2C device that's connected to an FSI CFAM
  (see fsi.txt). The I2CR translates I2C bus operations to FSI CFAM reads and
  writes or SCOM operations, thereby acting as an FSI master.

properties:
  compatible:
    enum:
      - ibm,i2cr-fsi-master

  reg:
    maxItems: 1

  "#address-cells":
    const: 2

  "#size-cells":
    const: 0

patternProperties:
  "cfam@[0-9a-f],[0-9a-f]":
    type: object
    properties:
      chip-id:
        $ref: /schemas/types.yaml#/definitions/uint32

      reg:
        maxItems: 1

      "#address-cells":
        const: 1

      "#size-cells":
        const: 1

    additionalProperties: true

  "scom@[0-9a-f]+":
    type: object
    properties:
      compatible:
        const: ibm,i2cr-scom

      reg:
        maxItems: 1

    additionalProperties: false

  "sbefifo@[0-9a-f]+":
    type: object
    properties:
      compatible:
        const: ibm,p9-sbefifo

      reg:
        maxItems: 1

      "#address-cells":
        const: 1

      "#size-cells":
        const: 0

    additionalProperties: false

required:
  - compatible
  - reg

additionalProperties: true

examples:
  - |
    i2c {
      #address-cells = <1>;
      #size-cells = <0>;

      i2cr@20 {
        compatible = "ibm,i2cr-fsi-master";
        reg = <0x20>;
      };
    };
```

## Documentation/devicetree/bindings/gpu/aspeed,ast2400-gfx.yaml
```yaml
# SPDX-License-Identifier: GPL-2.0
%YAML 1.2
---
$id: http://devicetree.org/schemas/gpu/aspeed,ast2400-gfx.yaml#
$schema: http://devicetree.org/meta-schemas/core.yaml#

title: Aspeed GFX display device

maintainers:
  - Andrew Jeffery <andrew@codeconstruct.com.au>

description: |
  The Aspeed BMC GFX device is a display controller separate to VGA from the
  host. A switch on the BMC side determines whether the DAC provides display
  output from the host VGA or BMC GFX controllers.

allOf:
  - $ref: /schemas/reserved-memory/memory-region.yaml#

properties:
  compatible:
    items:
      - enum:
          - aspeed,ast2400-gfx
          - aspeed,ast2500-gfx
      - const: syscon

  reg:
    maxItems: 1

  interrupts:
    maxItems: 1

  clocks:
    maxItems: 1

  resets:
    maxItems: 1

additionalProperties: true

examples:
  - |
    #include <dt-bindings/clock/aspeed-clock.h>
    reserved-memory {
        gfx_memory: framebuffer {
            size = <0x01000000>;
            alignment = <0x01000000>;
            compatible = "shared-dma-pool";
            reusable;
        };
    };
    syscon: syscon@1e6e2000 {
        compatible = "aspeed,ast2500-scu", "syscon", "simple-mfd";
        reg = <0x1e6e2000 0x1a8>;
        ranges = <0 0x1e6e2000 0x1000>;
        #address-cells = <1>;
        #size-cells = <1>;
        #clock-cells = <1>;
        #reset-cells = <1>;
    };
    display@1e6e6000 {
        compatible = "aspeed,ast2500-gfx", "syscon";
        reg = <0x1e6e6000 0x1000>;
        reg-io-width = <4>;
        clocks = <&syscon ASPEED_CLK_GATE_D1CLK>;
        resets = <&syscon ASPEED_RESET_CRT1>;
        interrupts = <0x19>;
        memory-region = <&gfx_memory>;
    };
```

## Documentation/devicetree/bindings/hwmon/aspeed,ast2400-pwm-tacho.yaml
```yaml
# SPDX-License-Identifier: (GPL-2.0-only OR BSD-2-Clause)
%YAML 1.2
---
$id: http://devicetree.org/schemas/hwmon/aspeed,ast2400-pwm-tacho.yaml#
$schema: http://devicetree.org/meta-schemas/core.yaml#

title: Aspeed PWM/Tachometer controller

maintainers:
  - Andrew Jeffery <andrew@codeconstruct.com.au>

description: |
  The Aspeed PWM/Tacho controller can support up to 8 fans. There are 8 PWM
  outputs and 16 tachometer inputs, where each fan may have up to two tachometer
  inputs associated with it.

properties:
  compatible:
    enum:
      - aspeed,ast2400-pwm-tacho
      - aspeed,ast2500-pwm-tacho

  reg:
    maxItems: 1

  "#address-cells":
    const: 1

  "#size-cells":
    const: 0

  clocks: true

  resets: true

  "#cooling-cells": true

patternProperties:
  "fan@[0-8]":
    type: object

    description: Fan node

    properties:
      reg:
        description: Fan source port
        maxItems: 1

      cooling-levels: true

      aspeed,fan-tach-ch:
        description: The fan tach input channels
        $ref: /schemas/types.yaml#/definitions/uint8-array
        minItems: 1
        maxItems: 2
        items:
          minimum: 0
          maximum: 15

    additionalProperties: false

additionalProperties: false

examples:
  - |
    #include <dt-bindings/clock/aspeed-clock.h>
    pwm_tacho: pwm@1e786000 {
        compatible = "aspeed,ast2500-pwm-tacho";
        reg = <0x1e786000 0x1000>;
        #address-cells = <1>;
        #size-cells = <1>;
        #cooling-cells = <2>;
        clocks = <&syscon ASPEED_CLK_APB>;
        resets = <&syscon ASPEED_RESET_PWM>;
        pinctrl-names = "default";
        pinctrl-0 = <&pinctrl_pwm0_default &pinctrl_pwm1_default>;

        fan@0 {
            reg = <0x00>;
            cooling-levels = /bits/ 8 <125 151 177 203 229 255>;
            aspeed,fan-tach-ch = /bits/ 8 <0x00>;
        };

        fan@1 {
            reg = <0x01>;
            aspeed,fan-tach-ch = /bits/ 8 <0x01 0x02>;
        };
    };
```

## Documentation/devicetree/bindings/interrupt-controller/aspeed,ast2400-i2c-ic.yaml
```yaml
# SPDX-License-Identifier: GPL-2.0
%YAML 1.2
---
$id: http://devicetree.org/schemas/interrupt-controller/aspeed,ast2400-i2c-ic.yaml#
$schema: http://devicetree.org/meta-schemas/core.yaml#

title: Aspeed I2C Interrupt Controller

maintainers:
  - Andrew Jeffery <andrew@codeconstruct.com.au>

description: |
  The Aspeed I2C controller contains an interrupt controller as a sub-block,
  managing interrupts for each of the I2C engines contained in the controller.

properties:
  compatible:
    enum:
      - aspeed,ast2400-i2c-ic
      - aspeed,ast2500-i2c-ic

  reg:
    maxItems: 1

  "#interrupt-cells":
    const: 1

  interrupts:
    maxItems: 1

  interrupt-controller: true

additionalProperties: false

examples:
  - |
    i2c_ic: interrupt-controller@0 {
        compatible = "aspeed,ast2400-i2c-ic";
        reg = <0x0 0x40>;
        #interrupt-cells = <1>;
        interrupts = <12>;
        interrupt-controller;
    };
```

## Documentation/devicetree/bindings/interrupt-controller/aspeed,ast2400-vic.yaml
```yaml
# SPDX-License-Identifier: GPL-2.0
%YAML 1.2
---
$id: http://devicetree.org/schemas/interrupt-controller/aspeed,ast2400-vic.yaml#
$schema: http://devicetree.org/meta-schemas/core.yaml#

title: Aspeed Vectored Interrupt Controller

maintainers:
  - Andrew Jeffery <andrew@codeconstruct.com.au>

description: |
  The AST2400 and AST2500 SoC families include a legacy register layout before
  a redesigned layout, but the bindings do not prescribe the use of one or the
  other.

allOf:
  - $ref: /schemas/interrupt-controller.yaml

properties:
  compatible:
    enum:
      - aspeed,ast2400-vic
      - aspeed,ast2500-vic

  interrupt-controller: true

  "#interrupt-cells":
    const: 1
    description:
      Specifies the number of cells needed to encode an interrupt source. It
      must be 1 as the VIC has no configuration options for interrupt sources.
      The single cell defines the interrupt number.

  valid-sources:
    $ref: /schemas/types.yaml#/definitions/uint32-array
    description:
      One cell, bitmap of support sources for the implementation

  reg:
    maxItems: 1

  interrupts:
    maxItems: 1

required:
  - compatible
  - reg
  - interrupt-controller
  - "#interrupt-cells"

additionalProperties: false

examples:
  - |
    vic: interrupt-controller@1e6c0080 {
         compatible = "aspeed,ast2400-vic";
         interrupt-controller;
         #interrupt-cells = <1>;
         reg = <0x1e6c0080 0x80>;
    };

...
```

## Documentation/devicetree/bindings/interrupt-controller/aspeed,ast2500-scu-ic.yaml
```yaml
# SPDX-License-Identifier: GPL-2.0
%YAML 1.2
---
$id: http://devicetree.org/schemas/interrupt-controller/aspeed,ast2500-scu-ic.yaml#
$schema: http://devicetree.org/meta-schemas/core.yaml#

title: Aspeed System Control Unit (SCU) Interrupt Controller

maintainers:
  - Eddie James <eajames@linux.ibm.com>
  - Andrew Jeffery <andrew@codeconstruct.com.au>

description: |
  The AST2500 and AST2600 BMC SoCs route reset status interrupts for PCIe, LPC
  and other peripherals via the SCU.

properties:
  compatible:
    enum:
      - aspeed,ast2500-scu-ic
      - aspeed,ast2600-scu-ic0
      - aspeed,ast2600-scu-ic1

  reg:
    minItems: 1

  interrupts:
    maxItems: 1

  interrupt-controller: true

  "#interrupt-cells":
    const: 1

required:
  - compatible
  - interrupts
  - interrupt-controller
  - "#interrupt-cells"

additionalProperties: false

examples:
  - |
    
    syscon@1e6e2000 {
        ranges = <0 0x1e6e2000 0x1a8>;

        scu_ic: interrupt-controller@18 {
            #interrupt-cells = <1>;
            compatible = "aspeed,ast2500-scu-ic";
            interrupts = <21>;
            interrupt-controller;
        };
    };
```

## Documentation/devicetree/bindings/media/aspeed,ast2400-video-engine.yaml
```yaml
# SPDX-License-Identifier: GPL-2.0
%YAML 1.2
---
$id: http://devicetree.org/schemas/media/aspeed,ast2400-video-engine.yaml#
$schema: http://devicetree.org/meta-schemas/core.yaml#

title: Aspeed Video Engine

maintainers:
  - Eddie James <eajames@linux.ibm.com>
  - Andrew Jeffery <andrew@codeconstruct.com.au>

description: |
  The Video Engine embedded in the Aspeed AST2400/AST2500/AST2600 SoCs can
  capture and compress video data from digital or analog sources

properties:
  compatible:
    enum:
      - aspeed,ast2400-video-engine
      - aspeed,ast2500-video-engine
      - aspeed,ast2600-video-engine

  reg:
    maxItems: 1

  clocks:
    minItems: 1
    maxItems: 2
    description: |
      Clock specifiers for the syscon clocks associated with the video engine.
      Ordering must match the clock-names property.

  clock-names:
    minItems: 1
    items:
      - const: vclk
      - const: eclk

  interrupts:
    maxItems: 1

  memory-region:
    description: A phandle to a reserved-memory region from which to allocate.

required:
  - compatible
  - reg
  - clocks
  - clock-names
  - interrupts

additionalProperties: false

examples:
  - |
    #include <dt-bindings/clock/aspeed-clock.h>
    video-engine@1e700000 {
        compatible = "aspeed,ast2500-video-engine";
        reg = <0x1e700000 0x20000>;
        clocks = <&syscon ASPEED_CLK_GATE_VCLK>, <&syscon ASPEED_CLK_GATE_ECLK>;
        clock-names = "vclk", "eclk";
        interrupts = <7>;
        memory-region = <&video_engine_memory>;
    };
```

## Documentation/devicetree/bindings/misc/aspeed,ast2400-p2a-ctrl.yaml
```yaml
# SPDX-License-Identifier: GPL-2.0
%YAML 1.2
---
$id: http://devicetree.org/schemas/misc/aspeed,ast2400-p2a-ctrl.yaml#
$schema: http://devicetree.org/meta-schemas/core.yaml#

title: Aspeed PCI2AHB (P2A) Bridge Controller

maintainers:
  - Andrew Jeffery <andrew@codeconstruct.com.au>

description: |
  The P2A bridge is available on platforms with the VGA enabled on the Aspeed
  device. In this case, the host has access to a relocatable 64KiB window into
  the BMC's physical address space. However, the BMC can disable this bridge.
  If the bridge is enabled, the host has read access to all regions of memory,
  however the host only write access to a defined set of regions controlled by
  the BMC.

properties:
  compatible:
    enum:
      - aspeed,ast2400-p2a-ctrl
      - aspeed,ast2500-p2a-ctrl

  reg:
    maxItems: 1

  memory-region: true

additionalProperties: false

required:
  - compatible

examples:
  - |
    p2a: p2a-control {
        compatible = "aspeed,ast2400-p2a-ctrl";
        memory-region = <&reserved_memory>;
    };
```

## Documentation/devicetree/bindings/misc/bmc-misc-ctrl.txt
```
BMC Miscellaneous Control Interfaces
====================================

Baseboard Management Controllers (BMCs) often have an array of hardware
features that need to be described but are awkward to sensibly expose.

This bindings document provides a generic mechanism for describing such
features, covering read-only (RO), read-modify-write (RMW) and
write-1-set/write-1-clear (W1SC) semantics.

The bindings are similar in nature to register-bit-led.

Required Properties
-------------------

compatible: 	Must be "bmc-misc-ctrl"

offset:		A one or three cell property describing the registers
		associated with the field.

		If the optional property 'set-clear' is not present then the
		node describes a register with read-modify-write semantics. The
		offset property has one cell describing the register of
		interest.

		If the optional property 'set-clear' is present then the node
		describes a register set that together implement read,
		write-1-set and write-1-clear semantics. The offset property
		must be three cells, the first is the address of the register
		to read from, the second the write-1-set register and the third
		write-1-clear.

mask: 		A mask whose set bits represent the bits of the field.

label:		The name of the field

Optional Properties
-------------------

read-only:	Define a read-only field (RMW/W1SC irrelevant).

set-clear:	Define whether the field exists in a RMW or W1SC register set

default-value:	Single cell applicable to RMW. The field will be updated to the
		cell's value.

default-set:	For W1SC, set all bits in the field

default-clear:	For W1SC, clear all bits in the field

Examples
--------

Describing a single-bit field at offset 6 in a read-modify-write register:

	field@80.6 {
		compatible = "bmc-misc-ctrl";
		offset = <0x80>;
		mask = <0x40>;
		label = "ilpc2ahb-disable";
		value = <1>;
	};

Describing a single-bit field at offset 6 in a write-1-set/write-1-clear
register set:

	field@70.6 {
		compatible = "bmc-misc-ctrl";
		set-clear;
		offset = <0x70 0x70 0x7c>
		bit-mask = <0x40>;
		default-set;
		label = "lpc-sio-decode-disable";
	};

Describe a field comprising an entire read-only register:

	field@50.0 {
		compatible = "bmc-misc-ctrl";
		offset = <0x50>;
		mask = <0xffffffff>;
		read-only;
		label = "vga-scratch-1";
	};
```
